## meta-guacamayo-bsp/conf/layer.conf
```bitbake
# We have a conf and classes directory, add to BBPATH
BBPATH =. "${LAYERDIR}:"

# We have a packages directory, add to BBFILES
BBFILES += "${LAYERDIR}/recipes-*/*/*.bb \
            ${LAYERDIR}/recipes-*/*/*.bbappend"

BBFILE_COLLECTIONS += "guacamayo-bsp"
BBFILE_PATTERN_guacamayo-bsp = "^${LAYERDIR}/"
BBFILE_PRIORITY_guacamayo-bsp = "16"
```

## meta-guacamayo-bsp/conf/machine/atom-egl.conf
```bitbake
#@TYPE: Machine
#@NAME: Atom-PC

#@DESCRIPTION: Machine configuration for Intel Atom based PCs

require atom-pc.inc

MACHINE_FEATURES += "guacamayo-egl"

PREFERRED_PROVIDER_virtual/egl = "mesa-dri-egl"
PREFERRED_PROVIDER_virtual/libgl = "mesa-dri-egl"
PREFERRED_PROVIDER_virtual/libgles2 = "mesa-dri-egl"

BBMASK .= "|.*/meta-ti/|.*/meta-raspberrypi|.*/recipes-bsp/ti-appends/|.*/recipes-bsp/rpi-appends"
```

## meta-guacamayo-bsp/conf/machine/atom-pc.conf
```bitbake
#@DESCRIPTION: Machine configuration for Intel Atom based PCs with integrated
# intel graphics.

require atom-pc.inc

MACHINE_FEATURES += "guacamayo-x11"

PREFERRED_PROVIDER_virtual/egl = "mesa-dri"
PREFERRED_PROVIDER_virtual/libgl = "mesa-dri"
```

## meta-guacamayo-bsp/conf/machine/nuc.conf
```bitbake
#@DESCRIPTION: Machine configuration for Intel NUC

require ../../../layers/meta-nuc/conf/machine/nuc.conf

ROOTLESS_X = "1"

MACHINE_FEATURES += "guacamayo-x11"

PREFERRED_PROVIDER_virtual/egl = "mesa-dri"
PREFERRED_PROVIDER_virtual/libgl = "mesa-dri"

MACHINE_EXTRA_RRECOMMENDS += "kernel-modules"

APPEND += "quiet"

BBMASK = ".*/meta-ti/|.*/meta-raspberrypi|.*/recipes-bsp/ti-appends/|.*/recipes-bsp/rpi-appends|.*/recipes-kernel/linux/linux-ti*|.*/meta-intel/common/recipes-graphics/mesa|.*/meta-nuc/recipes-bsp/alsa-state|.*/meta-nuc/recipes-core/initscripts"
```

## meta-guacamayo-bsp/conf/machine/raspberrypi.conf
```bitbake
#@TYPE: Machine
#@NAME: RaspberryPi Development Board
#@DESCRIPTION: Machine configuration for the RaspberryPi http://www.raspberrypi.org/ Board
# Based on meta-raspberrypi

require ../../../layers/meta-raspberrypi/conf/machine/raspberrypi.conf

GUI_MACHINE_CLASS = "bigscreen"

PREFERRED_PROVIDER_virtual/kernel = "linux-${MACHINE}"

PREFERRED_PROVIDER_virtual/xserver = "xserver-xorg"

XSERVER = " \
	xserver-xorg \
	xf86-input-evdev \
	xf86-input-mouse \
	xf86-input-keyboard \
	xf86-video-fbdev \
"

MACHINE_FEATURES = "kernel26 apm usbgadget usbhost keyboard vfat ext2 screen touchscreen alsa bluetooth wifi sdio"

MACHINE_FEATURES += "guacamayo-egl openmax"

MACHINE_EXTRA_RRECOMMENDS += " \
	kernel-modules \
"

PREFERRED_PROVIDER_virtual/egl = "vc-graphics"
PREFERRED_PROVIDER_virtual/libgles2 = "vc-graphics"

BBMASK = ".*/meta-yocto-bsp|.*/meta-ti/|.*/recipes-bsp/ti-appends/|.*/meta-raspberrypi/recipes-core/netbase|.*/meta-raspberrypi/recipes-core/psplash|.*/meta-raspberrypi/recipes-multimedia/libav/|.*/meta-ti/recipes-misc.*|/meta/recipes-graphics/mesa|.*/meta-guacamayo/recipes-graphics/mesa|.*/meta-intel|.*/meta-nuc"
```

## meta-guacamayo/conf/bblayers.conf.sample
```bitbake
# LAYER_CONF_VERSION is increased each time build/conf/bblayers.conf
# changes incompatibly
LCONF_VERSION = "6"

BBPATH = "${TOPDIR}"
BBFILES ?= ""
BBLAYERS = " \
  ##COREBASE##/meta \
  ##COREBASE##/meta-yocto \
  ##COREBASE##/meta-yocto-bsp \
  ##COREBASE##/meta-raspberrypi \
  ##COREBASE##/meta-ti \
  ##COREBASE##/meta-guacamayo-bsp \
  ##COREBASE##/meta-guacamayo \
  "
```

## meta-guacamayo/conf/distro/guacamayo.conf
```bitbake
# Poky slightly rebranded

require conf/distro/poky.conf

# We have a number of precompiled proprietrary binaries that fails on number
# of these checks (hash, rpaths), so warn rather than fail on these
ERROR_QA = "dev-so debug-deps dev-deps debug-files arch la2 pkgconfig la perms staticdev"
WARN_QA = "ldflags useless-rpaths rpaths unsafe-references-in-binaries unsafe-references-in-scripts libdir"

GUACA_VERSION_MAJOR="0"
GUACA_VERSION_MINOR="5"
GUACA_VERSION_MICRO="0"
GUACA_VERSION_NOTE="${@' (development snapshot)' if ${GUACA_VERSION_MINOR} % 2 else ''}"
GUACA_DISTRO_NAME = "Guacamayo"

export GUACA_VERSION_MAJOR
export GUACA_VERSION_MINOR
export GUACA_VERSION_MICRO
export GUACA_VERSION_NOTE
export GUACA_DISTRO_NAME

DISTRO = "guacamayo"
DISTRO_NAME = "${GUACA_DISTRO_NAME}"
DISTRO_VERSION = "${GUACA_VERSION_MAJOR}.${GUACA_VERSION_MINOR}.${GUACA_VERSION_MICRO}${GUACA_VERSION_NOTE}"
MAINTAINER = "Guacamayo Project <http://github.com/Guacamayo>"

DEFAULT_TIMEZONE ?= "Europe/London"
```

## meta-guacamayo/conf/distro/preferred-versions.conf
```bitbake
# default distro features -- get rid of 3g
DISTRO_FEATURES = "alsa argp ext2 largefile pcmcia usbhost wifi xattr nfs zeroconf pci x11 ${DISTRO_FEATURES_LIBC}"

PREFERRED_PROVIDER_virtual/xserver ?= "xserver-xorg"
PREFERRED_PROVIDER_virtual/kernel ?= "linux-yocto"

SRCREV_pn-guacamayo-mex-plugins = "b79c8826b852d1a7407d3ca8b11e51711dd2b513"
SRCREV_pn-media-explorer        = "81c4e462e361c9e2cae5cda55cd591f30244c27d"
SRCREV_pn-guacamayo-displayconf = "02ec642c9401d7e47f887a2e3524e108be734002"
SRCREV_pn-guacamayo-watchdog    = "4ee5003490aecf4e3554a5facee709b273150390"
SRCREV_pn-guacamayo-cli         = "b186c9c40c753088daacac70b2198db2e9ad703d"
```

## meta-guacamayo/conf/layer.conf
```bitbake
# Set a variable to get to the top of the metadata location
GUACABASE := '${@os.path.normpath("${LAYERDIR}/../")}'

# We have a conf and classes directory, add to BBPATH
BBPATH := "${LAYERDIR}:${BBPATH}"

# We have a packages directory, add to BBFILES
BBFILES := "${BBFILES} ${LAYERDIR}/recipes-*/*/*.bb \
            ${LAYERDIR}/recipes-*/*/*.bbappend"

BBFILE_COLLECTIONS += "guacamayo"
BBFILE_PATTERN_guacamayo := "^${LAYERDIR}/"
BBFILE_PRIORITY_guacamayo = "9"

require conf/distro/preferred-versions.conf
```

## meta-guacamayo/conf/machine/atom-egl.conf
```bitbake
#@TYPE: Machine
#@NAME: Atom-PC

#@DESCRIPTION: Machine configuration for Intel Atom based PCs

require atom-pc.conf

MACHINE_FEATURES = "screen keyboard pci usbhost ext2 ext3 x86 wifi acpi alsa"
MACHINE_FEATURES += "iwlagn guacamayo-egl"

PREFERRED_PROVIDER_virtual/egl = "mesa-dri-egl"
PREFERRED_PROVIDER_virtual/libgl = "mesa-dri-egl"
PREFERRED_PROVIDER_virtual/libgles2 = "mesa-dri-egl"

BBMASK .= "|.*/meta-ti/|.*/meta-raspberrypi|.*/recipes-bsp/ti-appends/|.*/recipes-bsp/rpi-appends"
```

## meta-guacamayo/conf/machine/atom-nvidia.conf
```bitbake
#@TYPE: Machine
#@NAME: Atom-PC

#@DESCRIPTION: Machine configuration for Intel Atom based machines with nvidia
#graphics.

require atom-pc.inc

MACHINE_FEATURES += "nvidia-gfx"

XSERVER = "xserver-xorg \
	   xf86-video-nvidia \
           xf86-input-mouse \
           xf86-input-keyboard \
           xf86-input-evdev \
           xf86-input-synaptics"

PREFERRED_PROVIDER_virtual/egl = "none"
PREFERRED_PROVIDER_virtual/libgl = "nvidia-display"
```

## meta-guacamayo/conf/machine/atom-pc.conf
```bitbake
#@DESCRIPTION: Machine configuration for Intel Atom based PCs with integrated
# intel graphics.

require ../../../layers/meta-yocto-bsp/conf/machine/atom-pc.conf

MACHINE_FEATURES += "iwlagn"

PREFERRED_PROVIDER_virtual/kernel = "linux-yocto"
PREFERRED_VERSION_linux-yocto = "3.4%"

MACHINE_EXTRA_RRECOMMENDS = "kernel-modules eee-acpi-scripts kernel-module-snd-hwdep kernel-module-snd-rawmidi kernel-module-snd-ua101 kernel-module-snd-usb-6fire kernel-module-snd-usb-audio kernel-module-snd-usb-caiaq kernel-module-snd-usbmidi-lib kernel-module-snd-usb-us122l kernel-module-snd-usb-usx2y kernel-module-rt2500usb kernel-module-rt2800lib kernel-module-rt2800usb kernel-module-rt2x00lib kernel-module-rt2x00usb"

APPEND += "quiet"

PREFERRED_PROVIDER_virtual/egl = "mesa-dri"
PREFERRED_PROVIDER_virtual/libgl = "mesa-dri"

BBMASK .= "|.*/meta-ti/|.*/meta-raspberrypi|.*/recipes-bsp/ti-appends/|.*/recipes-bsp/rpi-appends"
```

## meta-guacamayo/conf/machine/beagleboard.conf
```bitbake
require ../../../layers/meta-ti/conf/machine/beagleboard.conf

# must use = here, not ?=, as this gets parsed after our preferred-versions.conf
PREFERRED_PROVIDER_virtual/egl = "libgles-omap3"
PREFERRED_PROVIDER_cogl-1.10 = "cogl-1.10-egl"
PREFERRED_PROVIDER_clutter-1.10 = "clutter-1.10-egl"
PREFERRED_PROVIDER_clutter-gst-1.10 = "clutter-gst-1.10-egl"

MACHINE_FEATURES += "guacamayo-egl"

# Have to do this because various recipes in meta-ti use TOOLCHAIN_PATH
# so this saves up patching it all
export TOOLCHAIN_PATH="${STAGING_BINDIR_TOOLCHAIN}"

MACHINE_EXTRA_RRECOMMENDS += "kernel-modules"
```

## meta-guacamayo/conf/machine/beaglebone.conf
```bitbake
require ../../../layers/meta-ti/conf/machine/beaglebone.conf

# must use = here, not ?=, as this gets parsed after our preferred-versions.conf
PREFERRED_PROVIDER_virtual/egl = "libgles-omap3"

MACHINE_FEATURES += "guacamayo-egl"

# Have to do this because various recipes in meta-ti use TOOLCHAIN_PATH
# so this saves up patching it all
export TOOLCHAIN_PATH="${STAGING_BINDIR_TOOLCHAIN}"

MACHINE_EXTRA_RRECOMMENDS += "kernel-modules"

BBMASK .= "|.*/meta-raspberrypi|.*/recipes-bsp/rpi-appends"
```

## meta-guacamayo/conf/machine/raspberrypi.conf
```bitbake
#@TYPE: Machine
#@NAME: RaspberryPi Development Board
#@DESCRIPTION: Machine configuration for the RaspberryPi http://www.raspberrypi.org/ Board
# Based on meta-raspberrypi

TARGET_ARCH = "arm"

require conf/machine/include/tune-arm1176jzf-s.inc

GUI_MACHINE_CLASS = "bigscreen"

INHERIT += "sdcard_image-rpi"
IMAGE_FSTYPES += "tar.bz2 ext3 rpi-sdimg"

SERIAL_CONSOLE = "115200 ttyAMA0"

PREFERRED_PROVIDER_virtual/kernel = "linux-${MACHINE}"
MACHINE_KERNEL_PR = "r4"

PREFERRED_PROVIDER_virtual/xserver = "xserver-xorg"

XSERVER = " \
	xserver-xorg \
	xf86-input-evdev \
	xf86-input-mouse \
	xf86-input-keyboard \
	xf86-video-fbdev \
"

KERNEL_IMAGETYPE = "Image"

MACHINE_FEATURES = "kernel26 apm usbgadget usbhost keyboard vfat ext2 screen touchscreen alsa bluetooth wifi sdio"

MACHINE_FEATURES += "guacamayo-egl"

MACHINE_EXTRA_RRECOMMENDS += " \
	kernel-modules \
"

# Set GPU firmware image to be used
# arm128 : 128M ARM, 128M GPU split
# arm192 : 192M ARM, 64M GPU split
# arm224 : 224M ARM, 32M GPU split
RPI_GPU_FIRMWARE ?= "arm192"

PREFERRED_PROVIDER_virtual/egl = "vc-graphics"
PREFERRED_PROVIDER_virtual/gles2 = "vc-graphics"

BBMASK .= "|.*/meta-yocto-bsp|.*/meta-ti/|.*/recipes-bsp/ti-appends/|.*/meta-raspberrypi/recipes-core/netbase|.*/meta-raspberrypi/recipes-core/psplash|.*/meta/recipes-graphics/mesa|.*/meta-guacamayo/recipes-graphics/mesa"

RPIFW_SRCREV = "9f7cff0534c02cf7b2cab209886af3ff7be95a5c"
RPIFW_DATE = "20120920"
```

## meta-guacamole/conf/layer.conf
```bitbake
# We have a conf and classes directory, add to BBPATH
BBPATH := "${LAYERDIR}:${BBPATH}"

# We have a packages directory, add to BBFILES
BBFILES := "${BBFILES} ${LAYERDIR}/recipes-*/*/*.bb \
            ${LAYERDIR}/recipes-*/*/*.bbappend"

BBFILE_COLLECTIONS += "guacamole"
BBFILE_PATTERN_guacamole := "^${LAYERDIR}/"
BBFILE_PRIORITY_guacamole = "5"

require conf/preferred-versions.conf
```
